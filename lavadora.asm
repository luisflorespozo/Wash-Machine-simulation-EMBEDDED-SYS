__CONFIG _CP_OFF& _WDT_OFF& _PWRTE_ON& _XT_OSC
LIST P = 16F84
INCLUDE <P16F84.INC>

ESTATUS EQU	03H
PORTA	EQU	05H
PORTB	EQU	06H
TRISA	EQU	85H
TRISB	EQU	86H
CONTSEL	EQU 0CH
CONTEMP	EQU 0DH
AUXSEL	EQU 1CH
AUXTEM	EQU 2CH
PDel0 	EQU 1DH
PDel1 	EQU 2DH
CONTROL	EQU	3CH
CONTROL2	EQU	3DH
PAUSALLENADO	EQU	4DH

		ORG	00H
		BSF 	ESTATUS,5;	Para ir al banco 1
		CLRF	TRISA;		
		BSF		TRISA,3;	Para el sw1 del proceso
		BSF		TRISA,4;	Para el sw2 de la temperatura
		CLRF	TRISB;		Para poner todas las patitas en 0
		BCF		TRISB,3
		BSF		TRISB,7;	Para el sw3 del start/pause
		BCF		ESTATUS,5;	Para volver al banco 0

INICIO	CLRF	PORTA		; DP=0
		CLRF	PORTB		; MT-=MT+=LA=LV=LR=B=OFF
		BSF		PORTB,4;	Prendemos led rojo
		CLRF	CONTSEL		; CONTSEL=0 Selec proceso
		CLRF	CONTEMP		; CONTEMP=0 Selec temperatura
		CLRF	CONTROL;	BORRAMOS LAS VAR AUX DE CONTROL
		CLRF 	CONTROL2
		CLRF	PAUSALLENADO
SELECT	CALL	START
		BTFSC	PORTA,3		; SEL=0?
		GOTO	TEMPER
		CALL	DELAY
		INCF	CONTSEL,1			;CONTSEL=CONTSEL+1 Y SE GUARDA EN CONTSEL
		MOVLW	0X05			;CARGANDO W<=5
		SUBWF	CONTSEL,W;		HACEMOS CONTSEL-W Y SI ES CERO SE GUARDA EN ESTATUS,2
		BTFSS	ESTATUS,2; 		VERIFICAMOS SI ES CERO
		GOTO	MOSTRAR;		SI NO ES CERO VA A MOSTRAR EN EL DISPLAY
		GOTO	CHECK
		GOTO	TEMPER

TEMPER	CALL 	START;	PREGUNTAMOS SI SE PRECIONO START
AA		BTFSC	PORTA,4;	SW2 TEMPER=0?
		GOTO 	SELECT; SI NO APRETA VUELVE A PREGUNTAR EN SW1 SELECT
		CALL	DELAY;			SI SI, HACE EL CONTEO HASTA 70GRADOS
		INCF	CONTEMP,1			;CONTSEL=CONTSEL+1 Y SE GUARDA EN CONTSEL
		MOVLW	0X10			;CARGANDO W<=10
		SUBWF	CONTEMP,W
		BTFSS	ESTATUS,2
		GOTO	MOSTRAR2
		GOTO	SELECT
CHECK
		BCF		ESTATUS,2;	CONTROLAMOS QUE CONTSEL NO INCREMENTE MAS QUE 4
		MOVLW	0X05
		SUBWF	CONTSEL,W;	COMPARA 
		BTFSS	ESTATUS,2;	CONTEMP=4? 
		GOTO	TEMPER; si no es 1 va al control de temperatura
		CLRF	CONTSEL
		CLRF	PORTA
		GOTO 	TEMPER
		
MOSTRAR	MOVF	CONTSEL,0
		MOVWF	PORTA;	MOSTRAMOS EL VALOR DE CONTSEL EN EL DISPLAY
		BCF		ESTATUS,2
		BCF		PORTB,4; APAGAMOS EL LED ROJO DE READY
		BSF		PORTB,6;	PRENDEMOS EL LED VERDE DE TEMPERATURA
		GOTO	SELECT

MOSTRAR2
		MOVF	CONTEMP,0
		MOVWF	PORTA;		MUESTRA EL VALOR DE LA TEMPERATURA EN EL DISPLAY
		BCF		ESTATUS,2;	NOS ASEGURAMOS Q ESTE EN 0
		BCF		PORTB,4	;	APAGAMOS LED ROJO
		BSF		PORTB,6;	PRENDEMOS LED VERDE DE TEMP
		GOTO	AA;			VAMOS A LA SUBETIQUETA DE TEMPERATURA
		CLRF	AUXTEM;		LIMPIAMOS EL AUXILIAR DE TEMPERATURA
		MOVF	CONTSEL,0
		MOVWF	AUXSEL
		MOVF	CONTEMP,AUXTEM; HACEMOS AUXTEM<-CONTEMP
START
		BTFSC	PORTB,7;	PREGUNTAMOS SI SE APRETO START
		RETURN;				SI ES FALSO RETORNA
		GOTO 	PROCESO;	SI ES VERDADERO EMPIEZA EL PROCESO PEDIDO
PROCESO
CASO0
		BCF		ESTATUS,2;	NOS ASEGURAMOS QUE ESTE EN 0
		MOVLW	0X00;		CARGA 1 A W
		SUBWF	CONTSEL,W;	COMPARA 
		BTFSS	ESTATUS,2;	CONTSEL=1? 
		GOTO	CASO1;	SI NO ES VERDADERO VA A PREGUNTAR CASO2
		GOTO	START;	SI ES VERDADERO VA AL PRELAVADO	
CASO1
		BCF		ESTATUS,2;	NOS ASEGURAMOS QUE ESTE EN 0
		MOVLW	0X01;		CARGA 1 A W
		SUBWF	CONTSEL,W;	COMPARA 
		BTFSS	ESTATUS,2;	CONTSEL=1? 
		GOTO	CASO2;	SI NO ES VERDADERO VA A PREGUNTAR CASO2
		GOTO	PRELAVADO;	SI ES VERDADERO VA AL PRELAVADO
CASO2	
		BCF		ESTATUS,2;	NOS ASEGURAMOS QUE ESTE EN 0
		MOVLW	0X02;		CARGA 2 A W
		SUBWF	CONTSEL,W;	COMPARA 
		BTFSS	ESTATUS,2;	CONTSEL=2? 
		GOTO	CASO3;	SI NO ES VERDADERO VA A PREGUNTAR CASO3
		DECF	CONTSEL,1
		INCF	CONTEMP,1
		GOTO	LAVADO;	SI ES VERDADERO VA AL LAVADO
CASO3
		BCF		ESTATUS,2;	NOS ASEGURAMOS QUE ESTE EN 0
		MOVLW	0X03;		CARGA 3 A W
		SUBWF	CONTSEL,W;	COMPARA 
		BTFSS	ESTATUS,2;	CONTSEL=3?  
		GOTO	CASO4;	SI NO ES VERDADERO VA A PREGUNTAR CASO4
		CLRF	PORTB
		GOTO	ENJUAGADO;	SI ES VERDADERO VA AL ENJUAGADO
CASO4
		DECF	CONTROL,1
		BCF		ESTATUS,2;	NOS ASEGURAMOS QUE ESTE EN 0
		MOVLW	0X04;		CARGA 4 A W
		SUBWF	CONTSEL,W;	COMPARA 
		BTFSS	ESTATUS,2;	CONTSEL=4? 
		GOTO	CASO0;	SI NO ES VERDADERO VA A PREGUNTAR CASO1
		CLRF	PORTB
		GOTO	SECADO;	SI ES VERDADERO VA AL SECADO
PRELAVADO
		BCF		ESTATUS,2;	NOS ASEGURAMOS QUE ESTE EN 0
		MOVF	CONTSEL,W
		MOVWF	PORTA;		MOVEMOS EL VALOR DE LA SELECCION AL DISPLAY
		CLRF	PORTB
		BSF		PORTB,5;	PRENDEMOS EL LED DE LLENADO DE AGUA
		BSF		PORTB,6;	PRENDEMOS EL LED VERDE DE TEMPERATURA
		CALL	DELAYLLENADO
		CALL	DELAYLLENADO
		BCF		PORTB,5;	APAGAMOS LED DE LLENADO
		BCF		PORTB,6;	APAGAMOS LED DE TEMPERATURA
		INCF	CONTEMP,1;	INCREMENTAMOS CONTEMP+1 PARA SEGUIR AL SIGUIENTE PASO
		CLRF	PORTA
		CALL	DELAY
		CALL 	DELAY
CONTEO
		INCF	AUXTEM,1; INCREMENTAMOS EL VALOR DE TEMP
		MOVF	CONTEMP,0
		SUBWF	AUXTEM,W;	COMPARAMOS AUXTEM CON W( SI AUXTEM<CONTEMP
		BTFSS	ESTATUS,2
		GOTO	AUMENTARTEMP; SI NO ES VERDAD, VAMOS A AUXTEM+1 Y MOSTRAMOS EN EL DISPLAY EL INCREMENTO
		GOTO	MOTOR;		SI ES VERDAD NO AUMENTA MAS LA TEMPERATURA Y VA A MOVER EL MOTOR
		
AUMENTARTEMP
		BSF		PORTB,6	;	PRENDEMOS EL LED DE TEMPERATURA
		MOVF	AUXTEM,0;	 HACEMOS W<-AUXTEM
		MOVWF	PORTA
		CALL	DELAY2
		CALL	DELAY
		BCF		ESTATUS,2;	NOS ASEGURAMOS QUE ESTE 0
		GOTO	CONTEO	;	VAMOS A CONTEO (CICLO)
RETURN
MOTOR
		MOVF	CONTSEL,W
		MOVWF	PORTA;	MOSTRAMOS EN EL DISPLAY EL VALOR DE CONTSEL
		CLRF	PORTB
		BSF		PORTB,2;	MOTOR GIRA EN UN SENTIDO
		CALL 	ESPAUSA; 	pregunta si se apreto STOP
		CALL	DELAYMOTOR
		CALL 	ESPAUSA; 	pregunta si se apreto STOP
		BCF		PORTB,2
		BSF		PORTB,1;	MOTOR GIRA EN OTRO SENTIDO
		CALL 	ESPAUSA; 	pregunta si se apreto STOP
		CALL	DELAYMOTOR
		CALL 	ESPAUSA; 	pregunta si se apreto STOP
		BCF		PORTB,1
		BSF		PORTB,2
		CALL 	ESPAUSA; 	pregunta si se apreto STOP
		CALL	DELAYMOTOR
		CALL 	ESPAUSA; 	pregunta si se apreto STOP
		BSF		PORTB,3
		BCF		PORTB,2
		BSF		PORTB,1	
		CALL 	ESPAUSA; 	pregunta si se apreto STOP
		CALL	DELAYMOTOR
		CALL 	ESPAUSA; 	pregunta si se apreto STOP
		BCF		PORTB,1
		BSF		PORTB,2	
		CALL 	ESPAUSA; 	pregunta si se apreto STOP
		CALL	DELAYMOTOR
		BCF		PORTB,2
		CALL	DELAYMOTOR
		CALL	DELAYLLENADO
		CALL 	ESPAUSA; 	pregunta si se apreto STOP
		CLRF	PORTB

LAVADO	INCF	CONTSEL,1;	INCREMENTAMOS CONTSEL EN 1
		INCF	CONTROL,1;	INCREMENTAMOS LA VARIABLE CONTROL EN 1
		CLRF	AUXTEM;		LIMPIAMOS LA VARIABLE AUXTEM
		MOVF	CONTSEL,0
		MOVWF	PORTA;	MOSTRAMOS EL VALOR DE CONTSEL EN EL DISPLAY
		BSF		PORTB,5;	PRENDEMOS EL LED DE LLENADO DE AGUA
		CALL	DELAYLLENADO
		CALL	DELAYLLENADO
		BCF		PORTB,5
		CALL	DELAY;	 APAGAMOS EL LED DE LLENADO DE AGUA
		BCF		ESTATUS,2;	 NOS ASEGURAMOS QUE ESTE EN 0
		MOVLW	0X02;		HACEMOS W=2
		SUBWF	CONTROL,W;	COMPARAMOS CONTROL=2?
		BTFSS	ESTATUS,2
		GOTO	CONTEO;	SI ES FALSO VAMOS A CONTEO
		CLRF	PORTB
		GOTO	ENJUAGADO;	SI ES VERDADERO PASAMOS A ENJUAGADO

	
ENJUAGADO
		CLRF	AUXTEM;	BORRAMOS LA VARIABLE AUXTEM
		MOVF	CONTSEL,0
		MOVWF	PORTA;	MOVEMOS EL VALOR DE CONTSEL AL DISPLAY
		BSF		PORTB,5
		CALL	DELAYLLENADO
		CLRF	PORTB
		BSF		PORTB,2;	PRENDEMOS EL MOTOR EN UN SENTIDO
		CALL 	ESPAUSA; 	pregunta si se apreto STOP
		CALL	DELAYMOTOR
		CALL 	ESPAUSA; 	pregunta si se apreto STOP
		BCF		PORTB,2
		BSF		PORTB,1;	MOTOR GIRA EN OTRO SENTIDO
		CALL 	ESPAUSA; 	pregunta si se apreto STOP
		CALL	DELAYMOTOR
		CALL 	ESPAUSA; 	pregunta si se apreto STOP
		BCF		PORTB,1
		BSF		PORTB,2
		CALL 	ESPAUSA; 	pregunta si se apreto STOP
		CALL	DELAYMOTOR
		CALL 	ESPAUSA; 	pregunta si se apreto STOP
		BSF		PORTB,3;	PRENDEMOS LED DE VACIADO DE AGUA
		BCF		PORTB,2
		BSF		PORTB,1	
		CALL 	ESPAUSA; 	pregunta si se apreto STOP
		CALL	DELAYMOTOR
		CALL 	ESPAUSA; 	pregunta si se apreto STOP
		BCF		PORTB,1
		BSF		PORTB,2	
		CALL 	ESPAUSA; 	pregunta si se apreto STOP
		CALL	DELAYMOTOR
		BCF		PORTB,2
		CALL	DELAYMOTOR
		CALL	DELAYLLENADO
		CALL 	ESPAUSA; 	pregunta si se apreto STOP
		CLRF	PORTB

		INCF	CONTSEL,1;	 HACEMOS CONTSEL+1
		MOVF	CONTSEL,0
		MOVWF	PORTA;	MOSTRAMOS EN EL DISPLAY EL CONTSEL Y PASAMOS AL SECADO
		CALL	DELAY
SECADO		
		MOVF	CONTSEL,0
		MOVWF	PORTA;	MOSTRAMOS EL VALOR DE CONTSEL EN EL DISPLAY
		BSF		PORTB,3;	 PRENDEMOS LED DE VACIADO DE AGUA
		BSF		PORTB,2;	 PRENDEMOS MOTOR EN UN SENTIDO
		CALL	DELAYMOTOR
		CALL	DELAYMOTOR
		BCF		PORTB,2;	APAGAMOS MOTOR
FINAL
		CLRF	PORTA	
		BCF		PORTB,3;	APAGAMOS VACIADO DE AGUA
		CALL	DELAY
		BSF		PORTB,0;	PRENDEMOS LA BOCINA
		BSF		PORTB,4;	PRENDEMOSEL LED ROJO DE READY
		CALL	DELAY
		GOTO	INICIO;		VOLVEMOS AL INICIO PARA HACER OTRA OPERACION
		
ESPAUSA	
		BTFSC 	PORTB,7; 			pregunta por primera vez sw3=0?
		RETURN; 					si no se sale continua en lo que estaba
		MOVF 	CONTSEL,0; 				cargamos el valor de contsel en w
		MOVWF 	PORTA;			 	mostramos el valor de selec en el disp
		CLRF	PORTB
VUELTA	
				BSF		PORTB,4; 	 prende el led rojo
				BSF		PORTB,0;	prende la bocina
				CALL 	DELAY2
				BCF 	PORTB,4;	apaga el led rojo
				BCF		PORTB,0;	apaga la bocina
				CALL 	DELAY2
				BTFSC	PORTB,7; 	 vuelve a preguntar si sw4=0?
				GOTO 	VUELTA;     si no se volvio a apretar se queda parpadeando
		RETURN; 
ESPAUSALLENADO	
		;		CLRF	PAUSALLENADO
	;			BCF		ESTATUS,2
		BTFSC 	PORTB,7; 			pregunta por primera vez sw3=0?
		RETURN; 					si no se sale continua en lo que estaba
		MOVF 	CONTSEL,0; 				cargamos el valor de contsel en w
		MOVWF 	PORTA;			 	mostramos el valor de selec en el disp
		CLRF	PORTB
VUELTA2	
				BSF		PORTB,4; 	 prende el led rojo
				BSF		PORTB,0;	prende la bocina
				CALL 	DELAY2
				BCF 	PORTB,4;	apaga el led rojo
				BCF		PORTB,0;	apaga la bocina
				CALL 	DELAY2
				BTFSC	PORTB,7; 	 vuelve a preguntar si sw4=0?
				GOTO 	VUELTA2;     si no se volvio a apretar se queda parpadeando
				INCF	PAUSALLENADO,1
		RETURN; 



DELAY2  movlw     .253 ; 1 set numero de repeticion  (B)
       movwf     PDel0 ; 1
PLoop1  movlw     .253 ; 1 set numero de repeticion  (A)
       movwf     PDel1 ; 1
PLoop2  clrwdt ; 1 clear watchdog
       clrwdt ; 1 ciclo delay
       decfsz    PDel1,1 ; 1 + (1) es el tiempo 0  ? (A)
       goto      PLoop2 ; 2 no, loop
       decfsz    PDel0,1 ; 1 + (1) es el tiempo 0  ? (B)
       goto      PLoop1 ; 2 no, loop
PDelL1  goto PDelL2 ; 2 ciclos delay
PDelL2  
       return ; 2+2 Fin.

DELAY	CALL DELAY2
		CALL 	ESPAUSA; 	pregunta si se apreto STOP
		CALL DELAY2
		RETURN

DELAYLLENADO	
		CALL	DELAY
		CALL	DELAY
		CALL	DELAY
		CALL 	ESPAUSALLENADO; 	pregunta si se apreto STOP
				MOVLW	0X01;		HACEMOS W=2
				SUBWF	PAUSALLENADO,W;	COMPARAMOS PAUSALLENADO=1?
				BTFSC	ESTATUS,2
				RETURN;	SI ES FALSO VAMOS A CONTEO
		CALL	DELAY
		CALL 	ESPAUSALLENADO; 	pregunta si se apreto STOP
				MOVLW	0X01;		HACEMOS W=2
				SUBWF	PAUSALLENADO,W;	COMPARAMOS PAUSALLENADO=1?
				BTFSC	ESTATUS,2
				RETURN;	SI ES FALSO VAMOS A CONTEO
		CALL	DELAY
		CALL 	ESPAUSALLENADO; 	pregunta si se apreto STOP
				MOVLW	0X01;		HACEMOS W=2
				SUBWF	PAUSALLENADO,W;	COMPARAMOS PAUSALLENADO=1?
				BTFSC	ESTATUS,2
				RETURN;	SI ES FALSO VAMOS A CONTEO
		CALL	DELAY
		CALL 	ESPAUSALLENADO; 	pregunta si se apreto STOP
				MOVLW	0X01;		HACEMOS W=2
				SUBWF	PAUSALLENADO,W;	COMPARAMOS PAUSALLENADO=1?
				BTFSC	ESTATUS,2
				RETURN;	SI ES FALSO VAMOS A CONTEO
		CALL	DELAY
		CALL 	ESPAUSALLENADO; 	pregunta si se apreto STOP
				MOVLW	0X01;		HACEMOS W=2
				SUBWF	PAUSALLENADO,W;	COMPARAMOS PAUSALLENADO=1?
				BTFSC	ESTATUS,2
				RETURN;	SI ES FALSO VAMOS A CONTEO
		CALL	DELAY
		CALL 	ESPAUSALLENADO; 	pregunta si se apreto STOP
				MOVLW	0X01;		HACEMOS W=2
				SUBWF	PAUSALLENADO,W;	COMPARAMOS PAUSALLENADO=1?
				BTFSC	ESTATUS,2
				RETURN;	SI ES FALSO VAMOS A CONTEO
		CALL	DELAY
		CALL 	ESPAUSALLENADO; 	pregunta si se apreto STOP
				MOVLW	0X01;		HACEMOS W=2
				SUBWF	PAUSALLENADO,W;	COMPARAMOS PAUSALLENADO=1?
				BTFSC	ESTATUS,2
				RETURN;	SI ES FALSO VAMOS A CONTEO
		CALL	DELAY
		CALL 	ESPAUSALLENADO; 	pregunta si se apreto STOP
				MOVLW	0X01;		HACEMOS W=2
				SUBWF	PAUSALLENADO,W;	COMPARAMOS PAUSALLENADO=1?
				BTFSC	ESTATUS,2
				RETURN;	SI ES FALSO VAMOS A CONTEO
		CALL	DELAY
		CALL 	ESPAUSALLENADO; 	pregunta si se apreto STOP
				MOVLW	0X01;		HACEMOS W=2
				SUBWF	PAUSALLENADO,W;	COMPARAMOS PAUSALLENADO=1?
				BTFSC	ESTATUS,2
				RETURN;	SI ES FALSO VAMOS A CONTEO
		CALL	DELAY
		CALL 	ESPAUSALLENADO; 	pregunta si se apreto STOP
				MOVLW	0X01;		HACEMOS W=2
				SUBWF	PAUSALLENADO,W;	COMPARAMOS PAUSALLENADO=1?
				BTFSC	ESTATUS,2
				RETURN;	SI ES FALSO VAMOS A CONTEO
		CALL	DELAY
		CALL 	ESPAUSALLENADO; 	pregunta si se apreto STOP
				MOVLW	0X01;		HACEMOS W=2
				SUBWF	PAUSALLENADO,W;	COMPARAMOS PAUSALLENADO=1?
				BTFSC	ESTATUS,2
				RETURN;	SI ES FALSO VAMOS A CONTEO
		RETURN
DELAYMOTOR
	
		CALL	DELAY
		CALL	DELAY
		CALL 	ESPAUSA; 	pregunta si se apreto STOP
		CALL	DELAY
		CALL 	ESPAUSA; 	pregunta si se apreto STOP
		CALL	DELAY
		CALL 	ESPAUSA; 	pregunta si se apreto STOP
		CALL	DELAY
		CALL 	ESPAUSA; 	pregunta si se apreto STOP
		CALL	DELAY
		CALL 	ESPAUSA; 	pregunta si se apreto STOP
		CALL	DELAY
		CALL 	ESPAUSA; 	pregunta si se apreto STOP
		CALL	DELAY
		CALL 	ESPAUSA; 	pregunta si se apreto STOP
		CALL	DELAY
		CALL 	ESPAUSA; 	pregunta si se apreto STOP
		CALL	DELAY
		CALL 	ESPAUSA; 	pregunta si se apreto STOP
		CALL	DELAY
		CALL 	ESPAUSA; 	pregunta si se apreto STOP
		CALL	DELAY
		RETURN
RETURN

END
